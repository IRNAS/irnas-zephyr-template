## Kconfig
```kconfig
# This Kconfig file is picked by the Zephyr build system because it is defined
# as the module Kconfig entry point (see zephyr/module.yml).

rsource "drivers/Kconfig"
rsource "lib/Kconfig"
```

## boards/arm/custom_nrf52840dk/Kconfig.board
```kconfig
# Copyright (c) 2021 Nordic Semiconductor ASA
# SPDX-License-Identifier: Apache-2.0

config BOARD_CUSTOM_NRF52840DK
	bool "Custom NRF52840DK Board"
	depends on SOC_NRF52840_QIAA
```

## boards/arm/custom_nrf52840dk/Kconfig.defconfig
```kconfig
if BOARD_CUSTOM_NRF52840DK

config BOARD
	default "custom_nrf52840dk"

endif # BOARD_CUSTOM_NRF52840DK
```

## boards/arm/custom_nrf52840dk/custom_nrf52840dk_defconfig
```kconfig
# A Kconfig fragment that is merged as-is into the final build directory .config
# whenever an application is compiled for your board.

CONFIG_SOC_SERIES_NRF52X=y
CONFIG_SOC_NRF52840_QIAA=y
CONFIG_BOARD_CUSTOM_NRF52840DK=y

# Enable MPU
CONFIG_ARM_MPU=y

# Enable hardware stack protection
CONFIG_HW_STACK_PROTECTION=y

# Enable RTT
CONFIG_USE_SEGGER_RTT=y

# enable GPIO
CONFIG_GPIO=y

# enable uart driver
CONFIG_SERIAL=y

# enable console
CONFIG_CONSOLE=y
CONFIG_UART_CONSOLE=y
```

## boards/vendor/custom_board/board.yml
```yaml
# Copyright (c) 2024 Nordic Semiconductor ASA
# SPDX-License-Identifier: Apache-2.0

board:
  name: custom_board
  vendor: vendor
  revision:
    format: major.minor.patch
    default: 1.4.0
    exact: true
    revisions:
      - name: 1.0.0
      - name: 1.4.0
  socs:
    - name: nrf52840
```

## boards/vendor/custom_board/custom_board_defconfig
```kconfig
# A Kconfig fragment that is merged as-is into the final build directory .config
# whenever an application is compiled for your board.

# Enable MPU
CONFIG_ARM_MPU=y

# Enable hardware stack protection
CONFIG_HW_STACK_PROTECTION=y

# Enable RTT
CONFIG_USE_SEGGER_RTT=y

# enable GPIO
CONFIG_GPIO=y

# enable uart driver
CONFIG_SERIAL=y

# enable console
CONFIG_CONSOLE=y
CONFIG_UART_CONSOLE=y
```

## boards/vendor/custom_nrf52840dk/board.yml
```yaml
# Copyright (c) 2024 Nordic Semiconductor ASA
# SPDX-License-Identifier: Apache-2.0

board:
  name: custom_nrf52840dk
  vendor: vendor
  socs:
    - name: nrf52840
```

## lib/Kconfig
```kconfig
menu "Libraries"

rsource "fancy_ztest/Kconfig"
rsource "example_lib/Kconfig"

endmenu
```

## lib/example_lib/Kconfig
```kconfig
config EXAMPLE_LIB
	bool "example_lib support"
	help
        This option enables the example_lib library.
        This lib is used to demonstrate unit tests in ../tests/sample_test.
```

## lib/fancy_ztest/Kconfig
```kconfig
config FANCY_ZTEST
    bool "fancy ztest"
    select ZTEST_TC_UTIL_USER_OVERRIDE
    help
        Makes output of ztest fancy.
```

## samples/blinky/sample.yaml
```yaml
sample:
  name: Blinky Sample
common:
  tags:
    - release
  platform_allow:
    - custom_board@1.4.0
    - nrf52840dk/nrf52840

tests:
  sample.blinky: {}
```

## tests/sample_test/testcase.yaml
```yaml
tests:
  tests.sample_test.posix:
    # Set of platforms that this test case can be run on.
    platform_allow: native_sim
    harness: ztest
    # Only build the test, do not run it
    # build_only: True
    extra_configs:
      # Disable fancy test, otherwise stdout parsing does not work.
      - CONFIG_FANCY_ZTEST=n
  tests.sample_test.target:
    # Set of platforms that this test case can be run on.
    platform_allow: nrf52dk_nrf52832 nrf52840dk_nrf52840
    harness: ztest
    # Only build the test, do not run it
    # build_only: True
    extra_configs:
      # Disable fancy test, otherwise stdout parsing does not work.
      - CONFIG_FANCY_ZTEST=n
      # See https://github.com/zephyrproject-rtos/zephyr/issues/39216 to learn
      # why this flag is needed here.
      - CONFIG_NULL_POINTER_EXCEPTION_DETECTION_NONE=y
```
