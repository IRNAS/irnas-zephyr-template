## CMakeLists.txt
```
cmake_minimum_required(VERSION 3.20.0)

# Use conf as location of configuration files, to declutter the app folder
set(APPLICATION_CONFIG_DIR "${CMAKE_CURRENT_LIST_DIR}/conf")

find_package(Zephyr REQUIRED HINTS $ENV{ZEPHYR_BASE})

project(project)

target_sources(app PRIVATE src/main.c)
```

## Kconfig
```
menu "Zephyr Kernel"
source "$ZEPHYR_BASE/Kconfig.zephyr"
endmenu
```

## sample.yaml
```
sample:
  name: Main application firmware template example
common:
  sysbuild: true
  tags:
    - release
  platform_allow:
    - custom_board@1.0.0
    - custom_board@1.4.0
    - nrf52840dk/nrf52840

tests:
  app.prod:
    tags:
      - quick-build
    extra_overlay_confs:
      - with_mcuboot.conf

  app.uart:
    extra_overlay_confs:
      - debug.conf
      - uart.conf
      - with_mcuboot.conf

  app.debug:
    extra_overlay_confs:
      - debug.conf
    extra_args:
      - FILE_SUFFIX=dev

  app.rtt:
    extra_overlay_confs:
      - debug.conf
      - rtt.conf
    extra_args:
      - FILE_SUFFIX=dev

  app.native_sim:
    platform_allow:
      - native_sim
    extra_overlay_confs:
      - debug.conf
      - uart.conf
    extra_args:
      - FILE_SUFFIX=dev
    extra_configs:
      # Native sim has a GPIO emulator, so we can enable GPIO to get a buildable app. We will not see the LED
      # blinking, but we will see the logs.
      - CONFIG_GPIO=y
```

## sysbuild.conf
```
# Enable MCUBOOT
SB_CONFIG_BOOTLOADER_MCUBOOT=y

# Below path can look a bit confusing.
# At this point the APPLICATION_CONFIG_DIR is still unmodified, so it points to
# the directory where this sysbuild.conf file is located.
# But during the app build it gets modified (in the CMakeLists.txt) to point to
# the conf/ directory.
SB_CONFIG_BOOT_SIGNATURE_KEY_FILE="${APPLICATION_CONFIG_DIR}/signing_key.pem"
SB_CONFIG_BOOT_SIGNATURE_TYPE_ECDSA_P256=y
```

## prj.conf
```kconfig
# This is a Kconfig fragment which is considered common to all build variants
# and is always used.

CONFIG_PINCTRL=y

CONFIG_VERSION_INFO=y

CONFIG_BOARD_ENABLE_DCDC=n
```

## debug.conf
```kconfig
# This is a Kconfig fragment which can be used to enable debug-related options
# in the application.

# Compiler
# Compiler optimizations will be set to -Og independently of other options.
CONFIG_DEBUG_OPTIMIZATIONS=y
# This option adds additional information to the thread object, so that the
# debugger can discover the threads.
CONFIG_DEBUG_THREAD_INFO=y
# This option enables the addition of various information that can be
# used by debuggers in debugging the system, or enable additional debugging
# information to be reported at runtime.
CONFIG_DEBUG_INFO=y

# Logging
CONFIG_LOG=y
```

## rtt.conf
```kconfig
# This is a Kconfig fragment which can be used to enable Segger RTT options.
# It should be used in conjunction with debug.conf.

# Console
CONFIG_CONSOLE=y

# This is needed, printk is forced to use logging backend which is by default
# deffered
CONFIG_LOG_MODE_IMMEDIATE=y

# segger RTT console
CONFIG_USE_SEGGER_RTT=y
CONFIG_RTT_CONSOLE=y
```

## sysbuild_dev.conf
```kconfig
# Disable MCUBOOT for dev builds
SB_CONFIG_BOOTLOADER_MCUBOOT=n
```

## uart.conf
```kconfig
# This is a Kconfig fragment which can be used to enable UART console options.
# It should be used in conjunction with debug.conf.

# Console
CONFIG_CONSOLE=y

# UART console
CONFIG_SERIAL=y
CONFIG_UART_CONSOLE=y
```

## src/main.c
```c
/*
 * Copyright (c) 2016 Intel Corporation
 *
 * SPDX-License-Identifier: Apache-2.0
 */

#include <zephyr/drivers/gpio.h>
#include <zephyr/kernel.h>
#include <zephyr/logging/log.h>

#include <app_version.h>
#include <ncs_version.h>

LOG_MODULE_REGISTER(main);

#define SLEEP_TIME_MS (1 * MSEC_PER_SEC)

/*
 * A build error on this line means your board is unsupported.
 * See the sample documentation for information on how to fix this.
 */
static const struct gpio_dt_spec led = GPIO_DT_SPEC_GET(DT_ALIAS(led0), gpios);

/**
 * @brief Print firmware version and other useful information.
 */
static void prv_boot_msg(void)
{
	LOG_INF("---------------------------------------------");
	LOG_INF("App version:\t %s", APP_VERSION_EXTENDED_STRING);
	LOG_INF("App git hash:\t %s", STRINGIFY(APP_BUILD_VERSION));
	LOG_INF("NCS version:\t %s", NCS_VERSION_STRING);
	LOG_INF("Board:\t\t %s", CONFIG_BOARD);
	LOG_INF("---------------------------------------------");
}

int main(void)
{
	prv_boot_msg();

	int err;

	if (!device_is_ready(led.port)) {
		return -1;
	}

	err = gpio_pin_configure_dt(&led, GPIO_OUTPUT_ACTIVE);
	if (err) {
		LOG_ERR("Unable to configure LED GPIO, err: %d", err);
		return -1;
	}

	int count = 0;
	while (1) {
		LOG_INF("Hello world! Count %u", count++);

		err = gpio_pin_toggle_dt(&led);
		if (err) {
			LOG_ERR("Unable to toggle LED GPIO, err: %d", err);
			return -1;
		}
		k_sleep(K_MSEC(SLEEP_TIME_MS));
	}
}
```
